/*
    MIT License

    Copyright (c) 2016-2019, Alexey Dynda

    Permission is hereby granted, free of charge, to any person obtaining a copy
    of this software and associated documentation files (the "Software"), to deal
    in the Software without restriction, including without limitation the rights
    to use, copy, modify, merge, publish, distribute, sublicense, and/or sell
    copies of the Software, and to permit persons to whom the Software is
    furnished to do so, subject to the following conditions:

    The above copyright notice and this permission notice shall be included in all
    copies or substantial portions of the Software.

    THE SOFTWARE IS PROVIDED "AS IS", WITHOUT WARRANTY OF ANY KIND, EXPRESS OR
    IMPLIED, INCLUDING BUT NOT LIMITED TO THE WARRANTIES OF MERCHANTABILITY,
    FITNESS FOR A PARTICULAR PURPOSE AND NONINFRINGEMENT. IN NO EVENT SHALL THE
    AUTHORS OR COPYRIGHT HOLDERS BE LIABLE FOR ANY CLAIM, DAMAGES OR OTHER
    LIABILITY, WHETHER IN AN ACTION OF CONTRACT, TORT OR OTHERWISE, ARISING FROM,
    OUT OF OR IN CONNECTION WITH THE SOFTWARE OR THE USE OR OTHER DEALINGS IN THE
    SOFTWARE.
*/
/**
 *   Attiny85 PINS
 *             ____
 *   RESET   -|_|  |- 3V
 *   SCL (3) -|    |- (2)
 *   SDA (4) -|    |- (1)
 *   GND     -|____|- (0)
 *
 *   Atmega328 PINS: connect LCD to A4/A5
 */
#include "ssd1306.h"

const uint8_t Owl [] PROGMEM = {
0x00, 0x00, 0x00, 0x00, 0x00, 0x00, 0x00, 0x00, 0x00, 0x00, 0x00, 0x00, 0x00, 0x00, 0x00, 0x00,
0x00, 0x00, 0x00, 0x00, 0x00, 0x00, 0x00, 0x08, 0x00, 0x00, 0x00, 0x00, 0x00, 0x00, 0x00, 0x00,
0x00, 0x00, 0x00, 0x00, 0x00, 0x00, 0x00, 0x00, 0x00, 0x00, 0x00, 0x00, 0x00, 0x00, 0x00, 0x00,
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0x00, 0x00, 0x00, 0x00, 0x01, 0x00, 0x00, 0x00, 0x00, 0x00, 0x00, 0x00, 0x00, 0x00, 0x00, 0x00
};

/**
 * Soba bitmap source is generated via script from https://github.com/robertgallup/bmp2hex
 * MIT license
 */
const uint8_t G1 [] PROGMEM = {
0x00, 0x00, 0x00, 0x00, 0x00, 0x00, 0x00, 0x00, 0x00, 0x00, 0x00, 0x00, 0x00, 0x00, 0x00, 0x00,
0x00, 0x00, 0x00, 0x00, 0x00, 0x00, 0x00, 0x00, 0x00, 0x00, 0x00, 0x00, 0x00, 0x00, 0x00, 0x00,
0x00, 0x00, 0x00, 0x00, 0x00, 0x00, 0x00, 0x00, 0x00, 0x00, 0x00, 0x00, 0x00, 0x00, 0x00, 0x00,
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0x00, 0x00, 0x00, 0x00, 0x00, 0x00, 0x00, 0x00, 0x00, 0x00, 0x00, 0x00, 0x00, 0x00, 0x00, 0x00
};


const uint8_t G2 [] PROGMEM = {
0x00, 0x00, 0x00, 0x00, 0x00, 0x00, 0x00, 0x00, 0x00, 0x00, 0x00, 0x00, 0x00, 0x00, 0x00, 0x00,
0x00, 0x00, 0x00, 0x00, 0x00, 0x00, 0x00, 0x00, 0x00, 0x00, 0x00, 0x00, 0x00, 0x00, 0x00, 0x00,
0x00, 0x00, 0x00, 0x0F, 0xC0, 0x00, 0x00, 0x00, 0x00, 0x00, 0x00, 0x00, 0x00, 0x00, 0x00, 0x00,
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0x00, 0x00, 0x00, 0x00, 0x0E, 0x00, 0x00, 0x00, 0x00, 0x00, 0x00, 0x00, 0x00, 0x08, 0x00, 0xC0
};

const uint8_t G3 [] PROGMEM = {
0x00, 0x00, 0x00, 0x00, 0x00, 0x00, 0x00, 0x00, 0x00, 0x00, 0x00, 0x00, 0x0F, 0xFF, 0xFF, 0x00,
0x00, 0x00, 0x00, 0x00, 0x00, 0x00, 0x00, 0x00, 0x08, 0x00, 0x07, 0xFF, 0xF0, 0x00, 0xFF, 0x80,
0x00, 0x00, 0x00, 0x00, 0x00, 0x00, 0x00, 0x00, 0x0C, 0x07, 0xF8, 0x00, 0xFF, 0xFF, 0x00, 0x00,
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0x00, 0x00, 0x00, 0x00, 0x00, 0x00, 0x00, 0x00, 0x00, 0x00, 0x00, 0x00, 0x00, 0x00, 0x00, 0x00
};

//Pines de lectura
int mic = A3;
int p1 = A0;
int p2 = A1;
int p3 = A2;

int peticion,peticionLast;
int deseo1;
int deseo2;
int deseo3;

byte gli = 0;

//Secuencias de tiempo
long timeNow, timeLast, timeLec;
//Constantes de tiempo
const int changeG = 5000;
const int refreshLec = 15000;


//Configuración del programa
void setup()
{
  //Se inicia la comunicación serial
  Serial.begin (9600);
  Serial.println ("Hola");

  //Se inicializa la pantalla
  ssd1306_128x64_i2c_init();
  ssd1306_fillScreen(0x00);//Se pone la pantalla en negro
  ssd1306_drawBitmap(0, 0, 128, 64, Owl);//Se pone el logo de VJ-Joyas
  delay(3000);//Se espera 3 segundos

  //Se configura la pantalla para texto
  ssd1306_setFixedFont(ssd1306xled_font6x8);
  ssd1306_fillScreen(0x00);

  //Se inicia la secuencia de bienvenida de texto
  ssd1306_printFixed (0,  32, "Pulsera", STYLE_NORMAL);    
  ssd1306_printFixed (0,  40, "Liberadora", STYLE_NORMAL);    
  delay(2000);
  ssd1306_fillScreen(0x00);
  ssd1306_printFixed (0,  0, "Pulsera", STYLE_NORMAL);
  ssd1306_printFixed (0,  8, "liberadora", STYLE_NORMAL);
  delay (1500);
  ssd1306_printFixed (0, 24, "Dime tu deseo", STYLE_NORMAL);
  delay (1500);
  ssd1306_printFixed (0, 32, "y tratare de", STYLE_NORMAL);
  delay (1500);
  ssd1306_printFixed (0, 40, "darle una solucion", STYLE_NORMAL);
  delay (1500);
  ssd1306_printFixed (0, 48, "Sera una frase", STYLE_NORMAL);
  ssd1306_printFixed (0, 56, "reconfortate", STYLE_NORMAL);
  delay (3000);
  digitalWrite (A0, HIGH);
  digitalWrite (A1, HIGH);
  digitalWrite (A2, HIGH);
}


void loop()
{
  //Secuencia de tiempo
  timeNow = millis ();

  //Lectura de pines
//    peticion = analogRead (mic);
//    deseo1 = analogRead (p1);
//    deseo2 = analogRead (p2);
//    deseo3 = analogRead (p3);

  //Cada 5 segundos
//  if ((timeNow - timeLast) > changeG)
//  {
//    //Colocar dibujos
//    ssd1306_fillScreen(0x00);
//    gli++;
//    gli %= 3;
//    if (gli == 0)
//    {
//    ssd1306_drawBitmap(0, 0, 128, 64, G1);
//    }
//    else if (gli == 1)
//    {
//      ssd1306_drawBitmap(0, 0, 128, 64, G2);
//    }
//    else if (gli == 2)
//    {
//      ssd1306_drawBitmap(0, 0, 128, 64, G3);
//    }    
//    timeLast = timeNow;
//  }

  //Actualizar lectura de sensores
  peticion = analogRead (A3);
  if ((peticion - peticionLast > 100) || (peticionLast - peticion > 10))
  {

    //////Diagnostico
    /*
    ssd1306_fillScreen(0x00);//Limpiar pantalla
    char cstr[16];//Char array auxiliar
    //Lecturas
    peticion = analogRead (mic);
    deseo1 = analogRead (p1);
    deseo2 = analogRead (p2);
    deseo3 = analogRead (p3);
    
    itoa(peticion, cstr, 10);
    ssd1306_printFixed (0,  55, cstr, STYLE_NORMAL);    
    itoa(deseo1, cstr, 10);
    ssd1306_printFixed (30,  55, cstr, STYLE_NORMAL);    
    itoa(deseo2, cstr, 10);
    ssd1306_printFixed (60,  55, cstr, STYLE_NORMAL);    
    itoa(deseo3, cstr, 10);
    ssd1306_printFixed (90,  55, cstr, STYLE_NORMAL);
    Serial.println (peticion);
    */

    
    ssd1306_fillScreen(0x00);//Limpiar pantalla
 
    //Petición
    int p = peticion % 10;
      
      if (p == 0) {        
        ssd1306_printFixed (0,  32, "Tomatelo con calma", STYLE_NORMAL);
      }
      else if (p == 1) {
        ssd1306_printFixed (0,  32, "Esta hecho", STYLE_NORMAL);
      }
      else if (p == 2) {
        ssd1306_printFixed (0,  32, "Deja de consumir", STYLE_NORMAL);
      }
      else if (p == 3) {
        ssd1306_printFixed (0,  32, "El deseo no tiene    limite", STYLE_NORMAL);
      }
      else if (p == 4) {
        ssd1306_printFixed (0,  32, "La respuesta es un   sueno", STYLE_NORMAL);
      }
      else if (p == 5) {
        ssd1306_printFixed (0,  32, "Habla con ella", STYLE_NORMAL);
      }
      else if (p == 6) {
        ssd1306_printFixed (0,  32, "Pasado mañana        sucedera", STYLE_NORMAL);
      }
      else if (p == 7) {
        ssd1306_printFixed (0,  32, "En la historia esta  la respuesta", STYLE_NORMAL);
      }
      else if (p == 8) {
        ssd1306_printFixed (0,  32, "Resistencia y        deconstruccion", STYLE_NORMAL);
      }
      else if (p == 9) {
        ssd1306_printFixed (0,  32, "Transformalo", STYLE_NORMAL);
      }
      else if (p == 10) {
        ssd1306_printFixed (0,  32, "Desaprender", STYLE_NORMAL);
      }
      delay (10000);
      peticionLast = peticion;
        
    timeLec = timeNow;
  }
}
